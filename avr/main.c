/*
 * ============================================================
 * ATtiny85 HARDWARE WATCHDOG SUPERVISOR
 * ============================================================
 *
 * External hardware watchdog for a host microcontroller.
 *
 * The ATtiny85 monitors a heartbeat signal generated by the
 * host MCU. Any heartbeat transition indicates that the host
 * firmware is running.
 *
 * If no heartbeat transition is detected within the configured
 * timeout, the ATtiny85 performs a hardware reset of the host.
 *
 * After a reset, the host is given a configurable boot grace
 * period before heartbeat monitoring resumes.
 *
 * The ATtiny85 also uses its internal watchdog to recover if
 * the supervisor firmware itself becomes unresponsive.
 *
 * Target: ATtiny85
 * Clock:  1 MHz
 *
 * ============================================================
 */

#include <avr/io.h>
#include <avr/interrupt.h>
#include <avr/wdt.h>
#include <util/atomic.h>

#include <stdbool.h>
#include <stdint.h>


// ============================================================
// USER CONFIGURATION
// ============================================================

/*
 * Pin configuration
 *
 * ATtiny85 DIP-8:
 *
 *                  +---\/---+
 * RESET / PB5    1 |        | 8  VCC
 *               2 |        | 7
 *               3 |        | 6  PB1 / HOST_RESET
 * GND           4 |        | 5  PB0 / HEARTBEAT
 *                  +--------+
 */

#define PIN_HEARTBEAT       PB0
#define PIN_HOST_RESET      PB1


/*
 * Maximum time allowed without a heartbeat transition.
 */

#define HEARTBEAT_TIMEOUT_MS       3000UL


/*
 * Time given to the host to boot after a hardware reset.
 *
 * Heartbeat timeout detection is disabled during this period.
 */

#define HOST_BOOT_GRACE_MS        10000UL


/*
 * Duration of the hardware reset pulse.
 */

#define HOST_RESET_TIME_MS          200UL


/*
 * ATtiny internal watchdog timeout.
 */

#define WATCHDOG_TIMEOUT           WDTO_1S


// ============================================================
// CPU CONFIGURATION
// ============================================================

#ifndef F_CPU
#define F_CPU 1000000UL
#endif

#if F_CPU != 1000000UL
#error "This firmware requires F_CPU = 1 MHz"
#endif


// ============================================================
// SYSTEM CLOCK
// ============================================================

static volatile uint32_t system_ms = 0;


ISR(TIMER0_COMPA_vect)
{
    system_ms++;
}


static uint32_t millis_get(void)
{
    uint32_t value;

    ATOMIC_BLOCK(ATOMIC_RESTORESTATE)
    {
        value = system_ms;
    }

    return value;
}


// ============================================================
// HOST RESET CONTROL
// ============================================================

/*
 * The reset output behaves as an open-drain output.
 *
 * The PORT latch is permanently kept LOW.
 *
 * DDR = 0
 *     Input / Hi-Z
 *     Host reset line is released.
 *
 * DDR = 1
 *     Output LOW
 *     Host reset line is asserted.
 *
 * An external pull-up must keep the host reset line HIGH
 * while the ATtiny output is in the Hi-Z state.
 */

static inline void host_reset_release(void)
{
    DDRB &= ~(1 << PIN_HOST_RESET);
}


static inline void host_reset_assert(void)
{
    DDRB |= (1 << PIN_HOST_RESET);
}


// ============================================================
// HEARTBEAT INPUT
// ============================================================

static inline bool heartbeat_read(void)
{
    return (PINB & (1 << PIN_HEARTBEAT)) != 0;
}


// ============================================================
// HOST RESET
// ============================================================

static void host_reset(void)
{
    uint32_t start = millis_get();

    host_reset_assert();

    while ((uint32_t)(millis_get() - start) < HOST_RESET_TIME_MS)
    {
        wdt_reset();
    }

    host_reset_release();
}


// ============================================================
// TIMER
// ============================================================

static void timer0_init(void)
{
    /*
     * F_CPU = 1 MHz
     * Prescaler = 8
     *
     * Timer frequency:
     *
     *     1,000,000 / 8 = 125,000 Hz
     *
     * OCR0A = 124:
     *
     *     125 counts / 125,000 Hz = 1 ms
     */

    TCCR0A = 0;
    TCCR0B = 0;
    TCNT0  = 0;

    OCR0A = 124;

    TCCR0A = (1 << WGM01);
    TCCR0B = (1 << CS01);

    TIMSK |= (1 << OCIE0A);
}


// ============================================================
// INTERNAL WATCHDOG
// ============================================================

static void watchdog_init(void)
{
    MCUSR &= ~(1 << WDRF);

    wdt_reset();
    wdt_enable(WATCHDOG_TIMEOUT);
}


// ============================================================
// GPIO
// ============================================================

static void gpio_init(void)
{
    /*
     * Host reset output.
     *
     * Set the PORT latch LOW before configuring the pin.
     */

    PORTB &= ~(1 << PIN_HOST_RESET);
    DDRB  &= ~(1 << PIN_HOST_RESET);


    /*
     * Heartbeat input.
     *
     * Internal pull-up is disabled because the host actively
     * drives the heartbeat signal HIGH and LOW.
     */

    DDRB  &= ~(1 << PIN_HEARTBEAT);
    PORTB &= ~(1 << PIN_HEARTBEAT);


    host_reset_release();
}


// ============================================================
// MAIN
// ============================================================

int main(void)
{
    gpio_init();
    watchdog_init();
    timer0_init();

    sei();


    bool heartbeat_previous =
        heartbeat_read();

    uint32_t heartbeat_last_edge =
        millis_get();

    uint32_t heartbeat_grace_until =
        millis_get() + HOST_BOOT_GRACE_MS;


    for (;;)
    {
        /*
         * Keep the ATtiny's own watchdog alive.
         */

        wdt_reset();


        uint32_t now =
            millis_get();


        // ====================================================
        // HEARTBEAT EDGE DETECTION
        // ====================================================

        bool heartbeat =
            heartbeat_read();


        /*
         * Any HIGH -> LOW or LOW -> HIGH transition proves
         * that the host firmware is still producing heartbeat.
         */

        if (heartbeat != heartbeat_previous)
        {
            heartbeat_previous =
                heartbeat;

            heartbeat_last_edge =
                now;
        }


        // ====================================================
        // BOOT GRACE PERIOD
        // ====================================================

        /*
         * Signed subtraction keeps the comparison safe when
         * the millisecond counter wraps around.
         */

        bool grace_finished =
            (int32_t)(
                now - heartbeat_grace_until
            ) >= 0;


        // ====================================================
        // HEARTBEAT TIMEOUT
        // ====================================================

        if (
            grace_finished &&
            (uint32_t)(
                now - heartbeat_last_edge
            ) >= HEARTBEAT_TIMEOUT_MS
        )
        {
            /*
             * Host heartbeat stopped.
             *
             * Perform a hardware reset.
             */

            host_reset();


            /*
             * Start a new boot grace period.
             */

            now =
                millis_get();

            heartbeat_previous =
                heartbeat_read();

            heartbeat_last_edge =
                now;

            heartbeat_grace_until =
                now + HOST_BOOT_GRACE_MS;
        }


        /*
         * The host reset line should remain released during
         * normal operation.
         */

        host_reset_release();
    }
}
